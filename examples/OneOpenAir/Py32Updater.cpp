#include "Py32Updater.h"
#include <Arduino.h>
#include <Wire.h>
#include "firmware_image.h" // generated by tools/bootloader/package.py
namespace Py32Updater
{
    static constexpr uint8_t bootAddress = 0x43;
    static uint32_t u32(const uint8_t *p) { return uint32_t(p[0]) | uint32_t(p[1]) << 8 | uint32_t(p[2]) << 16 | uint32_t(p[3]) << 24; }
    static void put32(uint8_t *p, uint32_t v)
    {
        for (unsigned i = 0; i < 4; i++)
            p[i] = v >> (8 * i);
    }
    static bool status(uint8_t s[24])
    {
        if (Wire.requestFrom(bootAddress, size_t(24), true) != 24)
            return false;
        for (unsigned i = 0; i < 24; i++)
            s[i] = Wire.read();
        return !memcmp(s, "PYBL", 4) && s[4] == 1 && u32(s + 20) == 0x08001000;
    }
    static bool send(const uint8_t *f, unsigned n, unsigned waitMs)
    {
        Wire.beginTransmission(bootAddress);
        Wire.write(f, n);
        if (Wire.endTransmission(true) != 0)
            return false;
        delay(waitMs); // STOP before Flash operations; do not stream during erase/program.
        return true;
    }
    static bool awaitState(unsigned state, uint32_t offset, uint32_t timeout)
    {
        uint32_t start = millis();
        uint8_t s[24];
        do
        {
            if (status(s))
            {
                if (s[5] == 3)
                {
                    Serial.printf("BOOT_ERROR code=%u next=%lu\n", s[6], (unsigned long)u32(s + 8));
                    return false;
                }
                if (s[5] == state && u32(s + 8) == offset && u32(s + 12) == imageLength && u32(s + 16) == imageCrc)
                    return true;
            }
            delay(20);
        } while (millis() - start < timeout);
        return false;
    }
    // Read-only version-register check: never sends BEGIN, erase, or RUN.
    bool checkApplication(uint32_t timeout)
    {
        uint32_t start = millis();
        unsigned attempt = 0;
        do
        {
            Wire.beginTransmission(0x42);
            Wire.write(0x00);
            uint8_t tx = Wire.endTransmission(false);
            size_t received = 0;
            int version = -1;
            if (tx == 0)
            {
                received = Wire.requestFrom(uint8_t(0x42), size_t(1), true);
                if (received == 1)
                    version = Wire.read();
            }
            Serial.printf("APP_CHECK attempt=%u tx=%u rx=%u version=%d\n", ++attempt, tx, unsigned(received), version);
            if (tx == 0 && received == 1 && version == 1)
            {
                Serial.println("PASS: application protocol v1 responded at 0x42");
                return true;
            }
            delay(100);
        } while (millis() - start < timeout);
        return false;
    }
    static void resetPy32(int resetPin)
    {
        pinMode(resetPin, OUTPUT_OPEN_DRAIN);
        digitalWrite(resetPin, LOW);
        delay(2);
        digitalWrite(resetPin, HIGH);
    }

    bool update(int resetPin)
    {
        uint8_t s[24], f[32] = {0x80, 1};
        if (resetPin >= 0)
        {
            Serial.printf("Resetting PY32 via NRST on GPIO%d\n", resetPin);
            resetPy32(resetPin);
        }
        else
        {
            Serial.println("ARMED for 15 seconds. Reset/power-cycle ONLY the noise module now.");
        }
        uint32_t start = millis();
        bool found = false;
        while (millis() - start < 15000)
        {
            if (status(s))
            {
                found = true;
                break;
            }
            delay(50);
        }
        if (!found)
        {
            Serial.println("No bootloader at 0x43. No erase sent.");
            return false;
        }
        put32(f + 2, imageLength);
        put32(f + 6, imageCrc);
        put32(f + 10, imageLayout);
        if (!send(f, 14, 1000) || !awaitState(1, 0, 5000))
            return false;
        for (uint32_t offset = 0; offset < imageLength;)
        {
            unsigned count = min(uint32_t(16), imageLength - offset);
            f[1] = 2;
            put32(f + 2, offset);
            f[6] = count;
            memcpy(f + 7, firmwareImage + offset, count);
            if (!send(f, 7 + count, 10) || !awaitState(1, offset + count, 2000))
                return false;
            offset += count;
            if (offset % 1024 == 0 || offset == imageLength)
                Serial.printf("Written %lu/%lu\n", (unsigned long)offset, (unsigned long)imageLength);
        }
        f[1] = 3;
        if (!send(f, 2, 100) || !awaitState(2, imageLength, 3000))
            return false;
        Serial.println("VERIFIED_AND_COMMITTED (CRC integrity, NOT cryptographic authenticity)");
        f[1] = 4;
        if (!send(f, 2, 100))
            return false;
        // Allow startup to finish; report transport errors separately from version.
        if (!checkApplication())
        {
            Serial.println("Committed, but application version read failed; inspect via SWD. Do not assume boot success.");
            return false;
        }
        return true;
    }
} // namespace Py32Updater
